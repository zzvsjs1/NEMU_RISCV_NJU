## nemu/Kconfig
```kconfig
mainmenu "NEMU Configuration Menu"

config EXPERIMENTAL_UPSTREAM_ISA
  bool "Show experimental upstream ISA scaffolding"
  default n
  help
    Expose upstream ISA source snapshots that are kept in the tree for future
    ports. These targets are not part of the supported local RISC-V execution
    path yet, so leave this disabled for normal builds.

config UPSTREAM_ISA_COMPILE_TEST
  bool
  default n
  help
    Internal guard for ISA snapshots copied from upstream. Keep this disabled
    until those ISAs are adapted to the local decode, monitor, and DiffTest
    interfaces.

comment "Upstream x86, mips32, and loongarch32r scaffolding is copied but not selectable yet"
  depends on EXPERIMENTAL_UPSTREAM_ISA

choice
  prompt "Base ISA"
  default ISA_riscv32
config ISA_x86
  bool "x86"
  depends on EXPERIMENTAL_UPSTREAM_ISA && UPSTREAM_ISA_COMPILE_TEST
config ISA_mips32
  bool "mips32"
  depends on EXPERIMENTAL_UPSTREAM_ISA && UPSTREAM_ISA_COMPILE_TEST
config ISA_riscv32
  bool "riscv32"
config ISA_riscv64
  bool "riscv64"
config ISA_loongarch32r
  bool "loongarch32r"
  depends on EXPERIMENTAL_UPSTREAM_ISA && UPSTREAM_ISA_COMPILE_TEST
endchoice

config ISA_riscv
  bool
  default y if ISA_riscv32 || ISA_riscv64

config ISA
  string
  default "x86" if ISA_x86
  default "mips32" if ISA_mips32
  default "riscv32" if ISA_riscv32
  default "riscv64" if ISA_riscv64
  default "loongarch32r" if ISA_loongarch32r
  default "none"

config ISA64
  depends on ISA_riscv64
  bool
  default y

if ISA_riscv
source "src/isa/riscv32/Kconfig"
endif


choice
  prompt "NEMU execution engine"
  default ENGINE_INTERPRETER

config ENGINE_INTERPRETER
  bool "Interpreter"
  help
    Interpreter guest instructions one by one.
endchoice

config ENGINE
  string
  default "interpreter" if ENGINE_INTERPRETER
  default "none"

choice
  prompt "Running mode"
  default MODE_SYSTEM

config MODE_SYSTEM
  bool "System mode"
  help
    Support full-system functionality, including privileged instructions, MMU and devices.
endchoice

choice
  prompt "Build target"
  default TARGET_NATIVE_ELF
config TARGET_NATIVE_ELF
  bool "Executable on Linux Native"
config TARGET_SHARE
  bool "Shared object (used as REF for differential testing)"
  help
    Build NEMU as a shared library for differential-testing reference use.
config TARGET_AM
  bool "Application on Abstract-Machine"
endchoice

menu "Build Options"
choice
  prompt "Compiler"
  default CC_GCC
config CC_GCC
  bool "gcc"
config CC_GPP
  bool "g++"
config CC_CLANG
  depends on !TARGET_AM
  bool "clang"
endchoice

config CC
  string
  default "gcc" if CC_GCC
  default "g++" if CC_GPP
  default "clang" if CC_CLANG
  default "none"

choice
  prompt "Optimization Level"
  default CC_O2
config CC_O0
  bool "O0"
config CC_O1
  bool "O1"
config CC_O2
  bool "O2"
config CC_O3
  bool "O3"
endchoice

config CC_OPT
  string
  default "-O0" if CC_O0
  default "-O1" if CC_O1
  default "-O2" if CC_O2
  default "-O3" if CC_O3
  default "none"

config CC_LTO
  depends on !TARGET_AM
  bool "Enable link-time optimization"
  default n

config CC_DEBUG
  bool "Enable debug information"
  default n

config CC_ASAN
  depends on MODE_SYSTEM
  bool "Enable address sanitizer"
  default n
endmenu

menu "Testing and Debugging"


config TRACE
  bool "Enable tracer"
  default y

config TRACE_START
  depends on TRACE
  int "When tracing is enabled (unit: number of instructions)"
  default 0

config TRACE_END
  depends on TRACE
  int "When tracing is disabled (unit: number of instructions)"
  default 10000

config ITRACE
  depends on TRACE && TARGET_NATIVE_ELF && ENGINE_INTERPRETER
  bool "Enable instruction tracer"
  default y

config ITRACE_COND
  depends on ITRACE
  string "Only trace instructions when the condition is true"
  default "true"

config IRINGBUF
  depends on ITRACE
  bool "Enable instruction ring buffer"
  default n
  help
    Record recent instruction traces and dump them when NEMU aborts.

config IRINGBUF_SIZE
  depends on IRINGBUF
  int "Instruction ring buffer size"
  default 16

config WATCHPOINT
  depends on TARGET_NATIVE_ELF && ENGINE_INTERPRETER
  bool "Enable watchpoint"
  default y
  help
    Check active SDB watchpoints after each executed instruction.

config SDB_BATCH_DEFAULT
  depends on TARGET_NATIVE_ELF
  bool "Run SDB in batch mode by default"
  default n
  help
    Start execution immediately instead of entering the interactive SDB prompt.
    The -b/--batch command-line option remains available for configurations
    that keep this disabled.

config MTRACE
  depends on TRACE && TARGET_NATIVE_ELF
  bool "Enable memory access tracer"
  default n

config MTRACE_START
  depends on MTRACE
  hex "Only trace memory accesses from this physical address"
  default MBASE

config MTRACE_END
  depends on MTRACE
  hex "Only trace memory accesses before this physical address"
  default 0xffffffff
  help
    The default covers the full riscv32 physical address range. Set this
    together with MTRACE_START when only one device or memory window matters.

config DTRACE
  depends on TRACE && DEVICE && TARGET_NATIVE_ELF
  bool "Enable device access tracer"
  default n
  help
    Log device map reads and writes with the device name, guest PC, address,
    access width, and transferred data.

config FTRACE
  depends on TRACE && TARGET_NATIVE_ELF && ENGINE_INTERPRETER
  bool "Enable function call tracer"
  default n
  help
    Parse function symbols from an ELF file passed with --elf=FILE and
    trace RISC-V call/return instructions.

config E_TRACER
  depends on TRACE && TARGET_NATIVE_ELF && ENGINE_INTERPRETER
  bool "Enable etrace (exception trace)"
  default y


config DIFFTEST
  depends on TARGET_NATIVE_ELF
  bool "Enable differential testing"
  default n
  help
    Enable differential testing with a reference design.
    Note that this will significantly reduce the performance of NEMU.

choice
  prompt "Reference design"
  default DIFFTEST_REF_SPIKE if ISA_riscv
  default DIFFTEST_REF_KVM if ISA_x86
  default DIFFTEST_REF_QEMU
  depends on DIFFTEST
config DIFFTEST_REF_QEMU
  bool "QEMU, communicate with socket"
if ISA_riscv
config DIFFTEST_REF_SPIKE
  bool "Spike"
endif
if ISA_x86
config DIFFTEST_REF_KVM
  bool "KVM"
endif
endchoice

config DIFFTEST_REF_PATH
  string
  default "tools/qemu-diff" if DIFFTEST_REF_QEMU
  default "tools/kvm-diff" if DIFFTEST_REF_KVM
  default "tools/spike-diff" if DIFFTEST_REF_SPIKE
  default "none"

config DIFFTEST_REF_NAME
  string
  default "qemu" if DIFFTEST_REF_QEMU
  default "kvm" if DIFFTEST_REF_KVM
  default "spike" if DIFFTEST_REF_SPIKE
  default "none"
endmenu

menu "RISC-V32 JIT acceleration"
  depends on ISA_riscv32 && TARGET_NATIVE_ELF && ENGINE_INTERPRETER
  depends on !TRACE && !DIFFTEST && !WATCHPOINT && !MTRACE && !FTRACE

config RV32_JIT
  bool "Enable RISC-V32 x86-64 JIT"
  default y
  help
    Translate supported RISC-V32 basic blocks to native x86-64 code. When this
    is disabled or unavailable at run time, execution uses the normal
    interpreter path.

    The environment variable NEMU_DISABLE_JIT=1 can still disable this at run
    time for quick benchmark comparisons without changing the saved config.

config RV32_JIT_STATS
  bool "Collect RISC-V32 JIT statistics"
  depends on RV32_JIT
  default n
  help
    Count JIT cache hits, compiled blocks, executed blocks, helper calls and
    invalidations. This adds counter updates on hot paths, so leave it disabled
    for normal performance runs. When enabled in the binary, set
    NEMU_JIT_STATS=1 at run time to print the summary.

endmenu

menu "RISC-V64 execution acceleration"
  depends on ISA_riscv64 && TARGET_NATIVE_ELF && ENGINE_INTERPRETER
  depends on !TRACE && !DIFFTEST && !WATCHPOINT && !MTRACE && !FTRACE

config RV64_JIT
  bool "Enable RISC-V64 x86-64 JIT"
  default n
  help
    Translate supported RISC-V64 basic blocks to native x86-64 code. The first
    RV64 milestone is deliberately conservative: unsupported instructions,
    complex memory cases, traps, and debugging-sensitive behaviour fall back to
    the interpreter/helper path.

    The environment variable NEMU_DISABLE_JIT=1 can disable this at run time for
    interpreter/JIT A/B checks without changing the saved config.

config RV64_JIT_STATS
  bool "Collect RISC-V64 JIT statistics"
  depends on RV64_JIT
  default n
  help
    Count RV64 JIT cache hits, compiled blocks, executed blocks, helper exits,
    and invalidations. Leave this disabled for normal performance runs. When it
    is enabled in the binary, set NEMU_JIT_STATS=1 at run time to print the
    summary.

endmenu

if MODE_SYSTEM
source "src/memory/Kconfig"
source "src/device/Kconfig"
endif


menu "Miscellaneous"
choice
  depends on !TARGET_AM
  prompt "Host timer"
  default TIMER_GETTIMEOFDAY
config TIMER_GETTIMEOFDAY
  bool "gettimeofday"
config TIMER_CLOCK_GETTIME
  bool "clock_gettime"
endchoice

config RT_CHECK
  bool "Enable runtime checking"
  default y

endmenu
```

## nemu/configs/riscv32-am-headless-jit_defconfig
```kconfig
CONFIG_ISA_riscv32=y
CONFIG_ENGINE_INTERPRETER=y
CONFIG_MODE_SYSTEM=y
CONFIG_TARGET_NATIVE_ELF=y
CONFIG_CC_GCC=y
CONFIG_CC_O2=y
# CONFIG_TRACE is not set
# CONFIG_WATCHPOINT is not set
CONFIG_SDB_BATCH_DEFAULT=y
CONFIG_MSIZE=0x8000000
# CONFIG_MEM_RANDOM is not set
CONFIG_DEVICE=y
# CONFIG_VGA_SHOW_SCREEN is not set
CONFIG_VGA_SIZE_800x600=y
CONFIG_AUDIO_DUMMY=y
CONFIG_RV32_JIT=y
CONFIG_RV32_JIT_STATS=y
```

## nemu/configs/riscv64-am-headless-jit_defconfig
```kconfig
CONFIG_ISA_riscv64=y
CONFIG_ENGINE_INTERPRETER=y
CONFIG_MODE_SYSTEM=y
CONFIG_TARGET_NATIVE_ELF=y
CONFIG_CC_GCC=y
CONFIG_CC_O2=y
# CONFIG_TRACE is not set
# CONFIG_WATCHPOINT is not set
CONFIG_SDB_BATCH_DEFAULT=y
CONFIG_MSIZE=0x8000000
# CONFIG_MEM_RANDOM is not set
CONFIG_DEVICE=y
# CONFIG_VGA_SHOW_SCREEN is not set
CONFIG_AUDIO_DUMMY=y
CONFIG_RV64_JIT=y
CONFIG_RV64_JIT_STATS=y
```

## nemu/configs/riscv64-am-headless-spike_defconfig
```kconfig
CONFIG_ISA_riscv64=y
CONFIG_ENGINE_INTERPRETER=y
CONFIG_MODE_SYSTEM=y
CONFIG_TARGET_NATIVE_ELF=y
CONFIG_CC_GCC=y
CONFIG_CC_O2=y
# CONFIG_TRACE is not set
# CONFIG_WATCHPOINT is not set
CONFIG_DIFFTEST=y
CONFIG_DIFFTEST_REF_SPIKE=y
CONFIG_MSIZE=0x8000000
CONFIG_DEVICE=y
# CONFIG_VGA_SHOW_SCREEN is not set
CONFIG_AUDIO_DUMMY=y
```

## nemu/configs/riscv64-am-sdl_defconfig
```kconfig
CONFIG_ISA_riscv64=y
CONFIG_ENGINE_INTERPRETER=y
CONFIG_MODE_SYSTEM=y
CONFIG_TARGET_NATIVE_ELF=y
CONFIG_CC_GCC=y
CONFIG_CC_O2=y
# CONFIG_TRACE is not set
# CONFIG_WATCHPOINT is not set
CONFIG_SDB_BATCH_DEFAULT=y
CONFIG_MSIZE=0x8000000
CONFIG_DEVICE=y
CONFIG_HAS_VGA=y
CONFIG_VGA_SHOW_SCREEN=y
CONFIG_VGA_SIZE_400x300=y
CONFIG_HAS_AUDIO=y
# CONFIG_AUDIO_DUMMY is not set
```

## nemu/configs/riscv64-no-device_defconfig
```kconfig
CONFIG_ISA_riscv64=y
CONFIG_ENGINE_INTERPRETER=y
CONFIG_MODE_SYSTEM=y
CONFIG_TARGET_NATIVE_ELF=y
CONFIG_CC_GCC=y
CONFIG_CC_O2=y
# CONFIG_TRACE is not set
# CONFIG_WATCHPOINT is not set
CONFIG_SDB_BATCH_DEFAULT=y
CONFIG_MSIZE=0x8000000
# CONFIG_DEVICE is not set
```
