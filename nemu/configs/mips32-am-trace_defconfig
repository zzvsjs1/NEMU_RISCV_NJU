## nemu/configs/mips32-am-trace_defconfig
```kconfig
CONFIG_ISA_mips32=y
CONFIG_ENGINE_INTERPRETER=y
CONFIG_MODE_SYSTEM=y
CONFIG_TARGET_NATIVE_ELF=y
CONFIG_CC_GCC=y
CONFIG_CC_O2=y
CONFIG_TRACE=y
CONFIG_TRACE_END=100000000
# CONFIG_ITRACE is not set
CONFIG_FTRACE=y
CONFIG_E_TRACER=y
CONFIG_DTRACE=y
# CONFIG_WATCHPOINT is not set
CONFIG_SDB_BATCH_DEFAULT=y
CONFIG_MSIZE=0x8000000
# CONFIG_MEM_RANDOM is not set
CONFIG_DEVICE=y
# CONFIG_VGA_SHOW_SCREEN is not set
CONFIG_VGA_SIZE_800x600=y
CONFIG_AUDIO_DUMMY=y
```

## nemu/configs/x86-native_defconfig
```kconfig
CONFIG_ISA_x86=y
CONFIG_TARGET_NATIVE_ELF=y
# CONFIG_TRACE is not set
CONFIG_SDB_BATCH_DEFAULT=y
CONFIG_MSIZE=0x2000000
# CONFIG_DEVICE is not set
```

## nemu/src/isa/riscv32/Kconfig
```kconfig
menu "ISA-dependent Options for RISC-V"

config RV64
  bool
  default y if ISA_riscv64

config RISCV_FPU
  bool

config RISCV_D
  bool
  depends on RISCV_FPU

config RVE
  bool "Use E extension"
  depends on ISA_riscv32
  default n

config RV32_FPU
  bool "Enable RV32 F floating-point extension"
  depends on ISA_riscv32 && !RVE
  default y
  select RISCV_FPU
  help
    Provide the architectural RV32 single-precision floating-point state used
    by the interpreter and Berkeley SoftFloat implementation.

config RV32_D
  bool "Enable RV32 D double-precision floating-point extension"
  depends on RV32_FPU
  default n
  select RISCV_D
  help
    Widen the RV32 floating-point register file to 64 bits and implement the
    scalar D extension. Operations whose integer operands require XLEN=64
    remain unavailable, as required by the unprivileged ISA.

config RV64_FPU
  bool "Enable RV64 F and D floating-point extensions"
  depends on ISA_riscv64
  default y
  select RISCV_FPU
  select RISCV_D
  help
    Implement the scalar RV64 F and D extensions in the interpreter using
    Berkeley SoftFloat. The RV64 JIT continues to fall back to the interpreter
    for floating-point opcodes that it does not translate.

endmenu
```
